## drivers/input/touchscreen/Kconfig
```kconfig
#
# Touchscreen driver configuration
#
menuconfig INPUT_TOUCHSCREEN
	bool "Touchscreens"
	help
	  Say Y here, and a list of supported touchscreens will be displayed.
	  This option doesn't affect the kernel.

	  If unsure, say Y.

if INPUT_TOUCHSCREEN

source "drivers/input/touchscreen/synaptics_dsx_2.7/Kconfig"

config OF_TOUCHSCREEN
	def_tristate INPUT
	depends on INPUT

config SECURE_TOUCH
	bool "Secure Touch"
	depends on (TOUCHSCREEN_SYNAPTICS_I2C_RMI4 || \
	  TOUCHSCREEN_SYNAPTICS_DSX_I2C_v21)
	help
	  Say Y here to enable Secure Touch in supported drivers.

	  If unsure, say N.

source "drivers/input/touchscreen/NVT_Touch/Kconfig"

endif
```

## drivers/power/supply/qcom/Kconfig
```kconfig
menu "Qualcomm Technologies Inc Charger and Fuel Gauge support"

config QPNP_FG_GEN3
	tristate "QPNP GEN3 fuel gauge driver"
	depends on MFD_SPMI_PMIC
	help
	  Say Y here to enable the GEN3 Fuel Gauge driver. This adds support
	  for battery fuel gauging and state of charge of battery connected to
	  the fuel gauge. The state of charge is reported through a BMS power
	  supply property and also sends uevents when the capacity is updated.

config MSM_BCL_CTL
	bool "BCL Framework driver"
	help
	  Say Y here to enable this BCL Framework driver. This driver provides
	  interface, which can be used by the BCL h/w drivers to implement the
	  basic functionalities. This framework abstracts the underlying
	  hardware for the top level modules.

config MSM_BCL_PERIPHERAL_CTL
	bool "BCL driver to control the PMIC BCL peripheral"
	depends on SPMI
	depends on MSM_BCL_CTL
	help
	  Say Y here to enable this BCL PMIC peripheral driver. This driver
	  provides routines to configure and monitor the BCL
	  PMIC peripheral.

config BATTERY_BCL
	tristate "Battery Current Limit driver"
	depends on THERMAL_MONITOR
	help
	  Say Y here to enable support for battery current limit
	  device. The BCL driver will poll BMS if
	  thermal daemon enables BCL.
	  It will notify thermal daemon if IBat crosses Imax threshold.

config QPNP_SMB2
	tristate "SMB2 Battery Charger"
	depends on MFD_SPMI_PMIC
	help
	  Enables support for the SMB2 charging peripheral

endmenu
```
